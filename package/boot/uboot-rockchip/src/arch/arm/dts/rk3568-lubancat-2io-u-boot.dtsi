// SPDX-License-Identifier: GPL-2.0+
/*
 * (C) Copyright 2021 Rockchip Electronics Co., Ltd
 */

#include "rk3568-u-boot.dtsi"

/ {
	chosen {
		stdout-path = &uart2;
		u-boot,spl-boot-order = "same-as-spl", &sdmmc0, &sdhci;
	};
};

&sdmmc0 {
	bus-width = <4>;
	u-boot,spl-fifo-mode;
};

&uart2 {
	u-boot,dm-spl;
	clock-frequency = <24000000>;
	status = "okay";
};
